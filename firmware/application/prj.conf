## CMakeLists.txt
```
cmake_minimum_required(VERSION 3.20.0)
find_package(Zephyr REQUIRED HINTS $ENV{ZEPHYR_BASE})

project(blinky)

# Get the current git commit hash
execute_process(
    COMMAND uv run hatch version
    WORKING_DIRECTORY ${CMAKE_CURRENT_SOURCE_DIR}
    OUTPUT_VARIABLE HATCH_VERSION
    OUTPUT_STRIP_TRAILING_WHITESPACE
)

# get the current unix timestamp
string(TIMESTAMP FW_BUILD_TIMESTAMP "%s" UTC)


target_include_directories(app PRIVATE
    ${CMAKE_CURRENT_SOURCE_DIR}/src
)
# Add the commit hash as a compile definition
add_compile_definitions(FW_VERSION="${HATCH_VERSION}")
add_compile_definitions(FW_BUILD_TIMESTAMP=${FW_BUILD_TIMESTAMP}ULL)

add_subdirectory(src/imu_drivers)

target_sources(app PRIVATE
    src/main.c
    src/storage.c
    src/proximity.c
    src/audio.c
    src/imu.c
    src/battery_charge.c
    src/time_control.c
    src/cmd_processor.c
    src/privacy_switch.c
    src/status_led.c
    )
```

## Kconfig
```
source "Kconfig.zephyr"

menu "MIDGE CODE NEO application configuration"

config MCN_AUDIO_BUFFERS
    int "Audio Buffer count"
    default 5
    range 2 100
    help
        Number of audio buffers to use for audio input. Every audio buffer is
        4096 bytes in size.

config MCN_PROXIMITY_BUFFERS
    int "Proximity Buffer count"
    default 2
    range 2 100
    help
        Number of proximity buffers to use for proximity sensor data. Every
        proximity buffer contains 25 samples

endmenu
```

## prj.conf
```kconfig
# APPLICATION CONFIGURATION
#CONFIG_MIDGE_IMU_ICM20948_USE_CLOSED_DRIVER=n


# General
CONFIG_STD_C17=y
CONFIG_GNU_C_EXTENSIONS=y
CONFIG_CRC=y
CONFIG_REBOOT=y

CONFIG_PRINTK=y
CONFIG_LOG=y
CONFIG_MAIN_STACK_SIZE=2048
CONFIG_OUTPUT_DISASSEMBLY=y
#CONFIG_MISRA_SANE=y
#CONFIG_CODING_GUIDELINE_CHECK=y
CONFIG_COMPILER_WARNINGS_AS_ERRORS=y

# Bluetooth
CONFIG_BT=y
CONFIG_BT_PERIPHERAL=y
CONFIG_BT_ZEPHYR_NUS=y
CONFIG_BT_OBSERVER=y
CONFIG_BT_DEVICE_NAME="MingleMidge"
CONFIG_BT_MAX_CONN=1
CONFIG_BT_RX_STACK_SIZE=4096
## FASTER DOWNLOAD SPEED
CONFIG_BT_BUF_ACL_TX_COUNT=9
CONFIG_BT_BUF_EVT_RX_COUNT=10

# IMU
CONFIG_I2C=y
CONFIG_GPIO_ENABLE_DISABLE_INTERRUPT=y
CONFIG_SENSOR=y

# Audio
CONFIG_AUDIO=y
CONFIG_AUDIO_DMIC=y

# Battery charge
CONFIG_GPIO=y
CONFIG_ADC=y

# SDMMC
CONFIG_DISK_ACCESS=y
CONFIG_FILE_SYSTEM=y
CONFIG_FAT_FILESYSTEM_ELM=y
# need to add to doc
CONFIG_FS_FATFS_REENTRANT=y
CONFIG_FILE_SYSTEM_MKFS=y
# FILE_TYPE_MAX in storage.h + 1 for timesync file
CONFIG_FS_FATFS_NUM_FILES=8

# Mover a un overlay de conf (?)
CONFIG_DISK_DRIVER_SDMMC=y
CONFIG_SPI=y
CONFIG_BOOTLOADER_MCUBOOT=n

# PWM
CONFIG_LED=y

#CONFIG_TIMESLICE_SIZE=5
CONFIG_TIMESLICING=y
CONFIG_MAIN_THREAD_PRIORITY=0
#CONFIG_SCHED_SIMPLE=y

# callbacks command
CONFIG_SYSTEM_WORKQUEUE_STACK_SIZE=2048
CONFIG_CBPRINTF_FP_SUPPORT=y
```

## prj_debug.conf
```kconfig
CONFIG_DEBUG=y
CONFIG_DEBUG_OPTIMIZATIONS=y # Equivalent to -Og

CONFIG_CONSOLE=y
CONFIG_THREAD_NAME=y
CONFIG_LOG_THREAD_ID_PREFIX=y
```

## prj_release.conf
```kconfig
CONFIG_DEBUG=n
CONFIG_DEBUG_OPTIMIZATIONS=n # Equivalent to -Og
CONFIG_SPEED_OPTIMIZATIONS=y # Equivalent to -O2
CONFIG_CONSOLE=n
CONFIG_RTT_CONSOLE=n

# Required by LTO - still under testing for this application
# CONFIG_ISR_TABLES_LOCAL_DECLARATION=y
# CONFIG_LTO=y
```

## dts/bindings/audio/generic,pdm-mic.yaml
```yaml
description: Board microphone PDM electrical constraints

compatible: generic,pdm-mic

properties:
  min-pdm-clk-freq:
    type: int
    required: true
    description: Minimum allowed PDM clock frequency in Hz

  max-pdm-clk-freq:
    type: int
    required: true
    description: Maximum allowed PDM clock frequency in Hz

  min-pdm-clk-dc:
    type: int
    required: true
    description: Minimum allowed PDM clock duty cycle percentage

  max-pdm-clk-dc:
    type: int
    required: true
    description: Maximum allowed PDM clock duty cycle percentage
```

## src/main.c
```c
#include <zephyr/device.h>
#include <zephyr/kernel.h>
#include <zephyr/logging/log.h>
#include <zephyr/sys/util.h>

#include "audio.h"
#include "battery_charge.h"
#include "cmd_processor.h"
#include "imu.h"
#include "midge_protocol.h"
#include "privacy_switch.h"
#include "proximity.h"
#include "status_led.h"
#include "storage.h"
#include "time_control.h"

LOG_MODULE_REGISTER(main_module);
struct init_item {
    int (*fn)(void);
    const char* name;
};

static int run_inits(const struct init_item* items, size_t n) {
    int ret = 0;
    for (size_t i = 0; i < n; i++) {
        ret = items[i].fn();
        if (ret < 0) {
            LOG_ERR("Failed to initialize %s", items[i].name);
            break;
        }
    }
    led_report_status(ret);
    return ret;
}

int main() {
    int ret = led_init();
    if (ret < 0) {
        LOG_ERR("Failed to initialize LED");
        return ret;
    }

    const struct init_item inits[] = {
        {storage_init_fs, "storage"},
        {battery_charge_init, "battery charge sensor"},
        {audio_sensor_init, "audio sensor"},
        {switch_sensor_init, "switch sensor"},
        {proximity_sensor_init, "proximity sensor"},
        {imu_sensor_init, "IMU sensor"},
        {cmd_processor_init, "command processor"},
    };

    ret = run_inits(inits, ARRAY_SIZE(inits));

    /*audio_sensor_start(2, 1);
    k_sleep(K_SECONDS(60*3));
    audio_sensor_stop();*/
    led_report_active(false);
    return ret;
}

/** HACKS and WORKAROUNDS */

#ifdef CONFIG_BOARD_MIDGE_BADGE_V2

union pin_cfg {
    struct {
        uint32_t dir : 1;
        uint32_t input : 1;
        uint32_t pull : 2;
        uint32_t _reserved1 : 4;
        uint32_t drive : 3;
        uint32_t _reserved2 : 5;
        uint32_t sense : 2;
    };
    uint32_t raw;
};

static int lsm6dso_int_pin_hack(void) {
    // force the int pin as a output 0 during init so the imu can enter i2c mode
    // an be recognized during driver init

    // This code manually controls the GPIO block described in
    // https://docs.nordicsemi.com/r/bundle/ps_nrf52840/page/gpio.html
    uint32_t addr = 0x50000000;
    //*(volatile uint32_t *)(addr | 0x518) = (1<<30);
    //*(volatile uint32_t *)(addr | 0x508) = (1<<30);
    union pin_cfg cfg = {
        .dir = 1,  // output
        .input = 0,
        .pull = 1,
    };
    *(volatile uint32_t*)(addr | 0x778) = cfg.raw;

    return 0;
}

// Hook into PRE_KERNEL_1 with priority 50
SYS_INIT(lsm6dso_int_pin_hack, PRE_KERNEL_1, 50);

#endif
```

## src/audio.c
```c
#include "audio.h"

#include <stdbool.h>
#include <string.h>
#include <zephyr/audio/dmic.h>
#include <zephyr/devicetree.h>
#include <zephyr/kernel.h>
#include <zephyr/logging/log.h>

#include "midge_protocol.h"
#include "privacy_switch.h"
#include "storage.h"
#include "time_control.h"

LOG_MODULE_REGISTER(mb_audio);

#define MIC_PARAMS_NODE DT_ALIAS(mic_params)

#define SAMPLE_BIT_WIDTH 16
#define BYTES_PER_SAMPLE sizeof(int16_t)

/* Size of a block for 100 ms of audio data. */
#define BLOCK_SIZE(_sample_rate, _number_of_channels) \
    (BYTES_PER_SAMPLE * (_sample_rate / 10) * _number_of_channels)

/* Driver will allocate blocks from this slab to receive audio data into them.
 * Application, after getting a given block from the driver and processing its
 * data, needs to free that block.
 */
#define MAX_BLOCK_SIZE 4096  //(BLOCK_SIZE(MAX_SAMPLE_RATE, 2)) / 2
#define BLOCK_COUNT CONFIG_MCN_AUDIO_BUFFERS

struct k_mem_slab mem_slab;
char mem_slab_buffer[BLOCK_COUNT * MAX_BLOCK_SIZE] __aligned(4);

// K_MEM_SLAB_DEFINE_STATIC(mem_slab, MAX_BLOCK_SIZE, BLOCK_COUNT, 4);

const struct device* const dmic_dev = DEVICE_DT_GET(DT_NODELABEL(dmic_dev));

static const struct pdm_io_cfg microphone_cfg = {
    .min_pdm_clk_freq = DT_PROP(MIC_PARAMS_NODE, min_pdm_clk_freq),
    .max_pdm_clk_freq = DT_PROP(MIC_PARAMS_NODE, max_pdm_clk_freq),
    .min_pdm_clk_dc = DT_PROP(MIC_PARAMS_NODE, min_pdm_clk_dc),
    .max_pdm_clk_dc = DT_PROP(MIC_PARAMS_NODE, max_pdm_clk_dc),
};

struct pcm_stream_cfg stream = {
    .pcm_width = SAMPLE_BIT_WIDTH,
    .mem_slab = &mem_slab,
};

static struct {
    enum sensor_state state;
    struct dmic_cfg audio_config;
    uint16_t sample_iter;
    uint16_t high_sample_rate;
    uint8_t low_sample_rate_decimation;
} sensor_data = {.state = SENSOR_STATE_DISABLED,
                 .audio_config = {},
                 .sample_iter = 0,
                 .high_sample_rate = 20000,
                 .low_sample_rate_decimation = 16};

struct __attribute__((packed)) WavFileHeader {
    const uint8_t file_type_bloc_id[4];  // RIFF
    uint32_t file_size;                  // size of entire file minus 8 bytes

    // format bloc
    const uint8_t file_format_id[4];  // WAVE
    const uint8_t format_bloc_id[4];  // fmt
    const uint32_t format_bloc_size;  // 16 for 16-bit PCM
    const uint16_t audio_format;      // 1 for PCM
    uint16_t num_channels;            // 1 for mono, 2 for stereo
    uint32_t sample_rate;             // pcm_rate
    uint32_t byte_per_sec;            // sample_rate * num_channels * bits_per_sample/8
    uint16_t byte_per_bloc;           // num_channels * bits_per_sample/8
    const uint16_t bits_per_sample;

    // data bloc
    const uint8_t data_bloc_id[4];  // data
    uint32_t data_bloc_size;

    // data follows
} wav_hdr = {
    .file_type_bloc_id = {'R', 'I', 'F', 'F'},
    //.file_size = sizeof(data + header) - 8
    .file_format_id = {'W', 'A', 'V', 'E'},
    .format_bloc_id = {'f', 'm', 't', ' '},
    .format_bloc_size = 16,  // PCM,
    .audio_format = 1,       // PCM
    // .num_channels = 2,
    //.sample_rate = 20000,
    //.byte_per_sec = byte_per_sample * num_channels * sample_rate,
    //.byte_per_bloc = channels * 16 / 8,
    .bits_per_sample = SAMPLE_BIT_WIDTH,
    .data_bloc_id = {'d', 'a', 't', 'a'},
    //.data_bloc_size = sizeof(pcm data)
};

static int write_metadata(struct audio_meta_data* metadata) {
    char buffer[128];
    int len = snprintf(buffer, sizeof(buffer), "%" PRIu64 ",%d,%d,%d,%d,%d\n",
                       metadata->timestamp_ms, metadata->status_code, metadata->event_type,
                       metadata->frequency_hz, metadata->num_channels, metadata->decimation);
    if (len < 0) {
        LOG_ERR("Failed to format audio metadata, status %d\n", len);
        return -EFAULT;
    }

    int ret = storage_write(FILE_TYPE_AUDIO_METADATA, buffer, len);
    if (ret < 0) {
        LOG_ERR("Failed to write audio metadata, status %d\n", ret);
        // not aborting on metadata write failure since the sample data will still
        // be written and the metadata is not critical, although it provides useful
        // context for the sample
    }
    return ret;
}

uint8_t audio_sensor_get_status() { return (uint8_t)sensor_data.state; }

struct audio_sampling_work_ctx {
    struct k_work init_work;
    struct k_sem init_done;
    int init_ret;
    struct k_work_delayable process_work;
    struct k_sem stop_done;
    int stop_ret;
    int inter_sample_delay_ms;
} audio_sampling_work_ctx;

static void audio_sample_process_work_handler(struct k_work* work);

static void audio_init_sampling_work_handler(struct k_work* work) {
    struct audio_sampling_work_ctx* ctx =
        CONTAINER_OF(work, struct audio_sampling_work_ctx, init_work);
    int ret = 0;
    do {
        ret = storage_init_sample_file(FILE_TYPE_AUDIO, sensor_data.sample_iter);
        if (ret < 0) {
            LOG_ERR("Failed to open sampling file, status %d", ret);
            sensor_data.state = SENSOR_STATE_ERR;
            break;
        }

        // write header in advance
        ret = storage_write(FILE_TYPE_AUDIO, &wav_hdr, sizeof(wav_hdr));
        if (ret < 0) {
            LOG_ERR("Failed to write wav header, status %d", ret);
            sensor_data.state = SENSOR_STATE_ERR;
            storage_close(FILE_TYPE_AUDIO);
            break;
        }

        ret = storage_init_sample_file(FILE_TYPE_AUDIO_METADATA, sensor_data.sample_iter);
        char csv_header[] = "timestamp(ms),status,event,freq,channels,decimation\n";
        if (ret == 0) {
            // -1 to exclude null terminator
            ret = storage_write(FILE_TYPE_AUDIO_METADATA, csv_header, sizeof(csv_header) - 1);
        }
        if (ret < 0) {
            LOG_ERR("Failed to open metadata file, status %d", ret);
            sensor_data.state = SENSOR_STATE_ERR;
            storage_close(FILE_TYPE_AUDIO);
            break;
        }

        // trigger start
        ret = dmic_trigger(dmic_dev, DMIC_TRIGGER_START);
        if (ret < 0) {
            // error on trigger
            LOG_ERR("Failed to trigger start");
            sensor_data.state = SENSOR_STATE_ERR;
            storage_close(FILE_TYPE_AUDIO);
            storage_close(FILE_TYPE_AUDIO_METADATA);
            break;
        } else {
            bool decimate = switch_sensor_position() == PRIVACY_SWITCH_POS_LOW ? true : false;
            int decimation = decimate ? sensor_data.low_sample_rate_decimation : 1;
            struct audio_meta_data metadata = {
                .timestamp_ms = time_control_get_timestamp(),
                .status_code = 0,
                .event_type = AUDIO_EVENT_TYPE_TRIGGER_START,
                .frequency_hz = sensor_data.audio_config.streams->pcm_rate,
                .num_channels = sensor_data.audio_config.channel.act_num_chan,
                .decimation = decimation,
            };
            write_metadata(&metadata);
        }

        // calculate the expected time between samples.
        ctx->inter_sample_delay_ms =
            (sensor_data.audio_config.streams->block_size * 1000) /
            (sensor_data.audio_config.streams->pcm_rate *
             sensor_data.audio_config.channel.act_num_chan * BYTES_PER_SAMPLE);

        // submit audio sample process to system queue
        LOG_INF("starting audio sampling");
        k_work_init_delayable(&ctx->process_work, audio_sample_process_work_handler);
        int ret = k_work_schedule(&ctx->process_work, K_MSEC(ctx->inter_sample_delay_ms));

        if (ret < 0) {
            LOG_ERR("Failed to schedule audio sample processing work, status %d", ret);
            sensor_data.state = SENSOR_STATE_ERR;
            dmic_trigger(dmic_dev, DMIC_TRIGGER_STOP);
            storage_close(FILE_TYPE_AUDIO);
            storage_close(FILE_TYPE_AUDIO_METADATA);
        } else {
            sensor_data.state = SENSOR_STATE_ACTIVE;
        }
    } while (0);
    if (ret < 0) {
    }

    ctx->init_ret = ret;
    k_sem_give(&ctx->init_done);
}

static void audio_sample_process_work_handler(struct k_work* work) {
    struct k_work_delayable* dwork = k_work_delayable_from_work(work);
    struct audio_sampling_work_ctx* ctx =
        CONTAINER_OF(dwork, struct audio_sampling_work_ctx, process_work);
    bool decimate = switch_sensor_position() == PRIVACY_SWITCH_POS_LOW ? true : false;
    uint8_t decimation = decimate ? sensor_data.low_sample_rate_decimation : 1;
    void* audio_buffer;
    uint32_t audio_buffer_size;
    int ret;
    if (sensor_data.state == SENSOR_STATE_ACTIVE) {
        // read buffer
        ret = dmic_read(dmic_dev, 0, &audio_buffer, &audio_buffer_size, ctx->inter_sample_delay_ms);
        if (ret < 0) {
            // error on trigger
            if (ret == -EBUSY || ret == -ENOMSG || ret == -EAGAIN) {
                LOG_INF("Sample read timeout reached, sample most likely dropped, retriggering\n");
                struct audio_meta_data metadata = {
                    .timestamp_ms = time_control_get_timestamp(),
                    .status_code = ret,
                    .event_type = AUDIO_EVENT_TYPE_TRIGGER_START,
                    .frequency_hz = sensor_data.audio_config.streams->pcm_rate,
                    .num_channels = sensor_data.audio_config.channel.act_num_chan,
                    .decimation = decimation,
                };
                // drop all buffer data and re-init sampling
                k_mem_slab_init(&mem_slab, mem_slab_buffer, MAX_BLOCK_SIZE, BLOCK_COUNT);
                int retry_status = dmic_trigger(dmic_dev, DMIC_TRIGGER_START);
                if (retry_status < 0) {
                    LOG_ERR(
                        "Failed to retrigger start after sample read timeout, status %d, "
                        "aborting\n",
                        retry_status);
                    sensor_data.state = SENSOR_STATE_ERR;
                } else {
                    ret = write_metadata(&metadata);
                }
                // timestamp should be added to metadata file to keep track of dropped samples
            } else {
                LOG_ERR("unknown read err %d\n, sample probably dropped, aborting", ret);
                sensor_data.state = SENSOR_STATE_ERR;
            }
        } else {
            if (decimate) {
                int channels = sensor_data.audio_config.channel.act_num_chan;
                int step = BYTES_PER_SAMPLE * channels;
                int decimation = sensor_data.low_sample_rate_decimation;
                int jump = decimation * step;
                size_t decimated_size = audio_buffer_size / decimation;
                // uint8_t subsampled_buffer[decimated_size];

                uint8_t* subsampled_buffer_ptr =
                    (uint8_t*)audio_buffer + jump;  // in place compaction;
                for (int i = jump; i < audio_buffer_size; i += jump) {
                    memcpy(subsampled_buffer_ptr, (uint8_t*)audio_buffer + i, step);
                    subsampled_buffer_ptr += step;
                }

                ret = storage_write(FILE_TYPE_AUDIO, audio_buffer, decimated_size);
                wav_hdr.data_bloc_size += decimated_size;
            } else {
                ret = storage_write(FILE_TYPE_AUDIO, audio_buffer, audio_buffer_size);
                wav_hdr.data_bloc_size += audio_buffer_size;
            }
            k_mem_slab_free(&mem_slab, audio_buffer);
            if (ret < 0) {
                LOG_ERR("write sample failed \n");
                // sampling will stop, file system could be compromised.
                sensor_data.state = SENSOR_STATE_ERR;
            }
        }
    }

    if (sensor_data.state == SENSOR_STATE_ACTIVE) {
        k_work_reschedule(&ctx->process_work, K_NO_WAIT);
    } else {
        // trigger stop
        ret = dmic_trigger(dmic_dev, DMIC_TRIGGER_STOP);
        if (ret < 0) {
            // error on trigger
            LOG_ERR("trigger stop failed, critical error\n");
            sensor_data.state = SENSOR_STATE_ERR;
        } else {
            struct audio_meta_data metadata = {
                .timestamp_ms = time_control_get_timestamp(),
                .status_code = ret,
                .event_type = AUDIO_EVENT_TYPE_TRIGGER_STOP,
                .frequency_hz = sensor_data.audio_config.streams->pcm_rate,
                .num_channels = sensor_data.audio_config.channel.act_num_chan,
                .decimation = decimation,
            };
            ret = write_metadata(&metadata);

            sensor_data.state = SENSOR_STATE_STOP;
            LOG_INF("finished sampling round");

            // update the wav header with correct data and total file size info
            ret = storage_seek_start(FILE_TYPE_AUDIO);
            if (ret < 0) {
                LOG_ERR("Failed to seek to start of audio file to update header, status %d", ret);
                sensor_data.state = SENSOR_STATE_ERR;
            } else {
                // add total data size to header
                wav_hdr.file_size = wav_hdr.data_bloc_size + sizeof(wav_hdr) - 8;
                ret = storage_write(FILE_TYPE_AUDIO, &wav_hdr, sizeof(wav_hdr));
                if (ret < 0) {
                    LOG_ERR("Failed to update wav header with file info, status %d", ret);
                    sensor_data.state = SENSOR_STATE_ERR;
                }
            }

            ret = storage_close(FILE_TYPE_AUDIO);
            int ret2 = storage_close(FILE_TYPE_AUDIO_METADATA);
            if ((ret < 0) || (ret2 < 0)) {
                LOG_ERR("Failed to close files, status samples: %d  metadata: %d", ret, ret2);
                sensor_data.state = SENSOR_STATE_ERR;
                ret = (ret < 0) ? ret : ret2;  // return the error code of the first failure, if any
            }
        }
        ctx->stop_ret = ret;
        k_sem_give(&ctx->stop_done);
    }
}

int audio_sensor_start(int sample_iter, uint16_t high_sample_rate,
                       uint8_t low_sample_rate_decimation, int mode) {
    // Validate input parameters
    if (mode != AUDIO_MODE_MONO && mode != AUDIO_MODE_STEREO) {
        LOG_ERR("Invalid audio mode %d", mode);
        return -EINVAL;
    }
    if (low_sample_rate_decimation == 0) {
        LOG_ERR("Low sample rate decimation cannot be zero");
        return -EINVAL;
    }
    if (high_sample_rate % low_sample_rate_decimation != 0) {
        LOG_ERR("High sample rate must be divisible by low sample rate decimation");
        return -EINVAL;
    }
    if (MAX_BLOCK_SIZE % low_sample_rate_decimation != 0) {
        LOG_ERR("Decimation must be a factor of the max block size");
        return -EINVAL;
    }
    if (high_sample_rate / low_sample_rate_decimation > 2000) {
        LOG_ERR(
            "The low sample rate decimation is too low. It must be high enough to produce "
            "privacy-preserving sample rates.");
        return -EINVAL;
    }

    // Get sampling freq based on switch position
    enum privacy_sw_pos switch_pos = switch_sensor_position();

    // configurar canales
    memset(&sensor_data.audio_config, 0,
           sizeof(struct dmic_cfg));  // clear configuration

    sensor_data.audio_config.channel.req_num_streams = 1;
    sensor_data.audio_config.io = microphone_cfg;

    sensor_data.audio_config.channel.req_num_chan = mode;
    switch (mode) {
        case AUDIO_MODE_MONO: {
            sensor_data.audio_config.channel.req_chan_map_lo =
                dmic_build_channel_map(0, 0, PDM_CHAN_LEFT);
        } break;
        case AUDIO_MODE_STEREO: {
            sensor_data.audio_config.channel.req_chan_map_lo =
                dmic_build_channel_map(0, 0, PDM_CHAN_LEFT) |
                dmic_build_channel_map(1, 0, PDM_CHAN_RIGHT);
        } break;
        default: {
            sensor_data.state = SENSOR_STATE_STOP;
            return -EINVAL;
        }
    }

    switch (switch_pos) {
        // Both use the same sample freq, the output buffer is manually
        // decimated as the hw may not support low sample rates
        case PRIVACY_SWITCH_POS_LOW:
        case PRIVACY_SWITCH_POS_HIGH: {
            stream.pcm_rate = high_sample_rate;
            stream.block_size = MAX_BLOCK_SIZE;  // BLOCK_SIZE(HIGH_SAMPLE_RATE, 1);
        } break;
        case PRIVACY_SWITCH_POS_OFF:
        default: {
            sensor_data.state = SENSOR_STATE_DISABLED;
            return -EACCES;
        }
    }
    sensor_data.audio_config.streams = &stream;
    int ret = dmic_configure(dmic_dev, &sensor_data.audio_config);
    if (ret < 0) {
        LOG_ERR("DMIC configuration failed");
        return ret;
    }
    sensor_data.high_sample_rate = high_sample_rate;
    sensor_data.low_sample_rate_decimation = low_sample_rate_decimation;

    sensor_data.sample_iter = sample_iter;

    // add file info to header
    wav_hdr.num_channels = sensor_data.audio_config.channel.act_num_chan;
    bool decimate = switch_sensor_position() == PRIVACY_SWITCH_POS_LOW ? true : false;
    uint32_t decimation = decimate ? sensor_data.low_sample_rate_decimation : 1;
    wav_hdr.sample_rate = sensor_data.audio_config.streams->pcm_rate / decimation;
    wav_hdr.byte_per_sec = BYTES_PER_SAMPLE * wav_hdr.num_channels * wav_hdr.sample_rate;
    wav_hdr.byte_per_bloc = BYTES_PER_SAMPLE * wav_hdr.num_channels;
    wav_hdr.data_bloc_size = 0;  // will be updated as samples are written

    memset(&audio_sampling_work_ctx, 0, sizeof(audio_sampling_work_ctx));
    k_sem_init(&audio_sampling_work_ctx.init_done, 0, 1);
    k_sem_init(&audio_sampling_work_ctx.stop_done, 0, 1);

    k_work_init(&audio_sampling_work_ctx.init_work, audio_init_sampling_work_handler);
    int submit_ret = k_work_submit(&audio_sampling_work_ctx.init_work);

    if (submit_ret < 0) {
        LOG_ERR("Failed to submit audio sampling init work, status %d", submit_ret);
        ret = submit_ret;
    } else {
        k_sem_take(&audio_sampling_work_ctx.init_done, K_FOREVER);
        ret = audio_sampling_work_ctx.init_ret;
    }
    return ret;
}

int audio_sensor_stop() {
    int ret = 0;
    if (sensor_data.state != SENSOR_STATE_ACTIVE) {
        LOG_ERR("Invalid state to stop audio sampling, state %d", sensor_data.state);
        ret = -EPERM;
    } else {
        sensor_data.state = SENSOR_STATE_STOP;
        int ret = k_sem_take(&audio_sampling_work_ctx.stop_done, K_SECONDS(1));
        if (ret < 0) {
            LOG_ERR("Failed to take stop done semaphore, status %d, forcing work abort", ret);
            ret = k_work_cancel_delayable(&audio_sampling_work_ctx.process_work);
            sensor_data.state = SENSOR_STATE_ERR;
            if (ret < 0) {
                LOG_ERR("Failed to cancel audio processing work, status %d", ret);
            }
        } else {
            ret = audio_sampling_work_ctx.stop_ret;
        }
    }
    return ret;
}

int audio_sensor_init(void) {
    if (!device_is_ready(dmic_dev)) {
        LOG_ERR("%s is not ready", dmic_dev->name);
        sensor_data.state = SENSOR_STATE_ERR;
        return -1;
    }
    if (k_mem_slab_init(&mem_slab, mem_slab_buffer, MAX_BLOCK_SIZE, BLOCK_COUNT)) {
        LOG_ERR("Failed to initialize memory slab for audio samples");
        sensor_data.state = SENSOR_STATE_ERR;
        return -1;
    }
    sensor_data.state = SENSOR_STATE_STOP;
    LOG_INF("init ok");
    return 0;
}

int cmd_mic_start(uint8_t* data) {
    struct cmd_start_mic_request* req_data = (struct cmd_start_mic_request*)data;
    int ret = audio_sensor_start(req_data->sample_id, req_data->high_sample_rate,
                                 req_data->low_sample_rate_decimation, req_data->mode);
    memset(data, 0, sizeof(struct cmd_start_mic_response));
    struct cmd_start_mic_response* resp_data = (struct cmd_start_mic_response*)data;
    resp_data->status_code = ret;
    return ret;
}

int cmd_mic_stop(uint8_t* data) {
    // struct cmd_stop_mic_request* req_data = (struct cmd_stop_mic_request*)data;
    struct cmd_stop_mic_response* resp_data = (struct cmd_stop_mic_response*)data;
    int ret = audio_sensor_stop();
    resp_data->status_code = ret;
    return ret;
}
```

## src/audio.h
```c
#ifndef MB_AUDIO_H
#define MB_AUDIO_H

#include <inttypes.h>

uint8_t audio_sensor_get_status();

int audio_sensor_init();

enum audio_mode {
    AUDIO_MODE_MONO = 1,
    AUDIO_MODE_STEREO = 2,
};

struct audio_meta_data {
    uint64_t timestamp_ms;
    int status_code;
    enum {
        /// Multiple trigger start entries would mean samples were dropped, the timestamp provides
        /// an approximate reference to the timing of the dropped sample(s) although it is not exact
        AUDIO_EVENT_TYPE_TRIGGER_START = 0,
        AUDIO_EVENT_TYPE_TRIGGER_STOP = 1
    } event_type;
    uint16_t frequency_hz;  // only used for trigger start events to indicate the sampling frequency
                            // of the recorded samples
    uint8_t num_channels;
    uint8_t decimation;
};

// int proximity_sensor_change_config(uint16_t interval, uint16_t window);

int audio_sensor_start(int sample_iter, uint16_t high_sample_rate,
                       uint8_t low_sample_rate_decimation, int mode);

int audio_sensor_stop();

int cmd_mic_start(uint8_t* data);
int cmd_mic_stop(uint8_t* data);

#endif
```

## src/battery_charge.h
```c
#ifndef MB_BATTERY_CHARGE_H
#define MB_BATTERY_CHARGE_H

#include <inttypes.h>

int battery_charge_init();

int battery_charge_get_mv(int16_t* val_mv);

#endif
```

## src/cmd_processor.c
```c
#include "cmd_processor.h"

#include <inttypes.h>
#include <stdbool.h>
#include <stddef.h>
#include <string.h>
#include <zephyr/bluetooth/bluetooth.h>
#include <zephyr/bluetooth/services/nus.h>
#include <zephyr/kernel.h>
#include <zephyr/logging/log.h>
#include <zephyr/sys/reboot.h>
#include <zephyr/sys/util.h>

#include "audio.h"
#include "battery_charge.h"
#include "imu.h"
#include "midge_protocol.h"
#include "proximity.h"
#include "status_led.h"
#include "storage.h"
#include "time_control.h"

LOG_MODULE_REGISTER(cmd_processor);

struct custom_advertisement_data advertised_data = {
    .battery_mv = 0, .active_sensor_bitflags = 0, .badge_assignment = {.u16_all = 0xFFFF}};

// ======== Aggregate functionality command implementations ======== //

int cmd_setup_experiment(uint8_t* data) {
    struct cmd_setup_experiment_request* req_data = (struct cmd_setup_experiment_request*)data;
    struct cmd_setup_experiment_response* resp_data = (struct cmd_setup_experiment_response*)data;
    advertised_data.badge_assignment = req_data->badge_assignment;
    int ret = storage_init_experiment(req_data);
    if (ret < 0) {
        LOG_ERR("Failed to initialize experiment");
    } else {
        time_control_reset();
    }
    resp_data->status_code = ret;
    return ret;
}

int cmd_status(uint8_t* data) {
    LOG_INF("received status message");
    struct cmd_status_request* req_data = (struct cmd_status_request*)data;
    int64_t error = 0;
    int ret = time_control_sync(req_data->millis_since_epoch, &error);
    if (ret < 0) {
        LOG_ERR("time sync failed with error %d", ret);
    }
    int16_t mv = 0;
    ret = battery_charge_get_mv(&mv);
    if (ret < 0) {
        LOG_ERR("Failed to read battery voltage");
    }
    struct cmd_status_response* resp_data = (struct cmd_status_response*)data;
    memset(resp_data, 0, sizeof(struct cmd_status_response));
    resp_data->badge_assignment = advertised_data.badge_assignment;
    resp_data->sync_status = time_control_get_status();
    resp_data->sync_error_ms = error;
    resp_data->audio_state = audio_sensor_get_status();
    resp_data->battery_millivolts = mv;
    resp_data->proximity_state = proximity_sensor_get_status();
    resp_data->storage_status = storage_get_status();
    resp_data->imu_state = imu_sensor_get_status();
    return ret;
}

int cmd_get_fw_version(uint8_t* data) {
    // struct cmd_get_fw_version_request* req_data = (struct cmd_get_fw_version_request*)data;
    struct cmd_get_fw_version_response* resp_data = (struct cmd_get_fw_version_response*)data;
    LOG_INF("received get fw version message");
    memset(resp_data, 0, sizeof(struct cmd_get_fw_version_response));
    // null char at the end is enforced with the memset call and the size limit -1
    strncpy((char*)resp_data->version_str, FW_VERSION, sizeof(resp_data->version_str) - 1);
    LOG_INF("returning fw version: %s", resp_data->version_str);
    return 0;
}

static void reset_work_handler(struct k_work* work) {
    LOG_INF("Performing delayed reset...");
    sys_reboot(SYS_REBOOT_COLD);
}

static struct k_work_delayable reset_work;

int cmd_reset(uint8_t* data) {
    k_work_init_delayable(&reset_work, reset_work_handler);
    k_work_schedule(&reset_work, K_SECONDS(4));
    LOG_INF("received reset command, resetting...");

    struct cmd_reset_response* resp_data = (struct cmd_reset_response*)data;
    resp_data->status_code = 0;  // success
    return 0;
}

int cmd_identify(uint8_t* data) {
    struct cmd_identify_response* resp_data = (struct cmd_identify_response*)data;
    resp_data->status_code = led_identify();
    return 0;
}

enum cmd_state { READ_SOT, READ_CMD, READ_DATA, READ_EOT };

struct cmd_processor_lut_entry {
    uint8_t cmd_id;
    int req_data_size;
    int resp_data_size;
    int (*execute_cmd)(uint8_t* data);
};

struct cmd_processor_lut_entry commands[] = {
    {CMD_ID_RESET, sizeof(struct cmd_reset_request), sizeof(struct cmd_reset_response), cmd_reset},
    {CMD_ID_IDENTIFY, sizeof(struct cmd_identify_request), sizeof(struct cmd_identify_response),
     cmd_identify},
    {CMD_ID_SETUP_EXPERIMENT, sizeof(struct cmd_setup_experiment_request),
     sizeof(struct cmd_setup_experiment_response), cmd_setup_experiment},
    {CMD_ID_STATUS, sizeof(struct cmd_status_request), sizeof(struct cmd_status_response),
     cmd_status},
    {CMD_ID_GET_FW_VERSION, sizeof(struct cmd_get_fw_version_request),
     sizeof(struct cmd_get_fw_version_response), cmd_get_fw_version},
    {CMD_ID_START_MIC, sizeof(struct cmd_start_mic_request), sizeof(struct cmd_start_mic_response),
     cmd_mic_start},
    {CMD_ID_STOP_MIC, sizeof(struct cmd_stop_mic_request), sizeof(struct cmd_stop_mic_response),
     cmd_mic_stop},
    {CMD_ID_START_SCAN, sizeof(struct cmd_start_scan_request),
     sizeof(struct cmd_start_scan_response), cmd_scan_start},
    {CMD_ID_STOP_SCAN, sizeof(struct cmd_stop_scan_request), sizeof(struct cmd_stop_scan_response),
     cmd_scan_stop},
    {CMD_ID_START_IMU, sizeof(struct cmd_start_imu_request), sizeof(struct cmd_start_imu_response),
     cmd_start_imu},
    {CMD_ID_STOP_IMU, sizeof(struct cmd_stop_imu_request), sizeof(struct cmd_stop_imu_response),
     cmd_stop_imu},
    {CMD_ID_ERASE_SD, sizeof(struct cmd_erase_sd_request), sizeof(struct cmd_erase_sd_response),
     cmd_erase_sd},
    {CMD_ID_ERASE_FILE, sizeof(struct cmd_erase_file_request),
     sizeof(struct cmd_erase_file_response), cmd_erase_file},
    {CMD_ID_GET_FREE_SD_SPACE, sizeof(struct cmd_get_free_sd_space_request),
     sizeof(struct cmd_get_free_sd_space_response), cmd_get_free_sd_space},
    {CMD_ID_GET_FILE_INDEX_INFO, sizeof(struct cmd_get_file_index_info_request),
     sizeof(struct cmd_get_file_index_info_response), cmd_get_file_index_info},
    {CMD_ID_GET_FILE_CRC32, sizeof(struct cmd_get_file_crc32_request),
     sizeof(struct cmd_get_file_crc32_response), cmd_get_file_crc32},
    {CMD_ID_DOWNLOAD_FILE_CHUNK, sizeof(struct cmd_download_file_chunk_request),
     sizeof(struct cmd_download_file_chunk_response), cmd_download_file_chunk}};

#define COMMAND_COUNT ARRAY_SIZE(commands)

int invalid_cmd(uint8_t* data) {
    printf("ERROR IN CMD PROCESSOR CONTROL FLOW");
    return -EINVAL;
}

static void received(struct bt_conn* conn, const void* data, uint16_t len, void* ctx) {
    static enum cmd_state rx_cmd_state = READ_SOT;
    // SOT + CMD_ID + DATA + EOT
    static uint8_t cmd_data[INTERFACE_CMD_SZ];
    static int cmd_data_idx = 0;                             // currently read data
    static int cmd_req_data_size = 0;                        // how much data to read
    static int cmd_resp_data_size = 0;                       // how much data to send
    static int (*execute_cmd)(uint8_t* data) = invalid_cmd;  // ptr to command function

    // Get the negotiated MTU for the connection to determine how much data we
    // can send in one chunk
    int mtu = bt_gatt_get_mtu(conn) - 3;  // Subtract ATT header size
    ARG_UNUSED(ctx);
    LOG_DBG("%s() - Len: %d, Message: %.*s\n", __func__, len, len, (char*)data);
    const uint8_t* rx_data = (const uint8_t*)data;
    // State Machine
    for (int i = 0; i < len; i++) {
        uint8_t c = rx_data[i];

        switch (rx_cmd_state) {
            case READ_SOT:
                if (c == CMD_PROCESSOR_SOT) {
                    rx_cmd_state = READ_CMD;
                    cmd_data[0] = c;
                }
                break;
            case READ_CMD:
                bool cmd_is_valid = false;
                execute_cmd = invalid_cmd;  // default to invalid command
                for (int j = 0; j < COMMAND_COUNT; j++) {
                    if (c == commands[j].cmd_id) {
                        execute_cmd = commands[j].execute_cmd;
                        cmd_req_data_size = commands[j].req_data_size + 2;
                        cmd_resp_data_size = commands[j].resp_data_size + 2;
                        cmd_data[1] = c;
                        cmd_data_idx = 2;
                        rx_cmd_state = READ_DATA;
                        cmd_is_valid = true;
                        break;
                    }
                }
                if (!cmd_is_valid) {
                    // invalid command, go back to read SOT
                    rx_cmd_state = READ_SOT;
                    LOG_ERR("Received invalid command ID: %c", c);
                } else {
                    LOG_DBG("Received valid command ID: %c, expecting %d bytes of data", c,
                            cmd_req_data_size - 2);
                }

                break;
            case READ_DATA:
                cmd_data[cmd_data_idx] = c;
                cmd_data_idx++;
                if (cmd_data_idx < cmd_req_data_size) {
                    // keep reading

                } else {
                    // already read all data
                    rx_cmd_state = READ_EOT;
                }
                break;
            case READ_EOT:
                if (c == CMD_PROCESSOR_EOT) {
                    // valid termination
                    execute_cmd(&cmd_data[2]);
                    cmd_data[cmd_resp_data_size] = CMD_PROCESSOR_EOT;
                    // total message size: resp data (includes EOT and cmd_id) + SOT
                    // Send data in chunks of 20 bytes
                    int total_bytes = cmd_resp_data_size + 1;
                    int bytes_sent = 0;
                    while (bytes_sent < total_bytes) {
                        int chunk_size =
                            (total_bytes - bytes_sent) > mtu ? mtu : (total_bytes - bytes_sent);
                        int chunk_stat =
                            bt_nus_send(conn, (void*)&cmd_data[bytes_sent], chunk_size);
                        if (chunk_stat == -ENOMEM || chunk_stat == -EAGAIN) {
                            k_msleep(1);
                            continue;
                        } else if (chunk_stat < 0) {
                            LOG_ERR("Failed to send data over BLE: %d", chunk_stat);
                            break;
                        }
                        bytes_sent += chunk_size;
                    }
                } else {
                    // invalid termination
                }
                rx_cmd_state = READ_SOT;
                break;
            default:
                rx_cmd_state = READ_SOT;
        }
    }
}

/// =========================================
/// BLE
/// =========================================

#define DEVICE_NAME CONFIG_BT_DEVICE_NAME
#define DEVICE_NAME_LEN (sizeof(DEVICE_NAME) - 1)

static struct bt_data ad[] = {
    BT_DATA_BYTES(BT_DATA_FLAGS, (BT_LE_AD_GENERAL | BT_LE_AD_NO_BREDR)),
    BT_DATA(BT_DATA_NAME_COMPLETE, DEVICE_NAME, DEVICE_NAME_LEN),
    BT_DATA(BT_DATA_MANUFACTURER_DATA, (const uint8_t*)&advertised_data, sizeof(advertised_data)),
};

static struct bt_data sd[] = {
    BT_DATA_BYTES(BT_DATA_UUID128_ALL, BT_UUID_NUS_SRV_VAL),
};

static struct k_work_delayable advertised_data_work;
static void advertised_data_work_handler(struct k_work* work) {
    ARG_UNUSED(work);
    LOG_DBG("Updating advertised data");
    int16_t mv = 0;
    if (battery_charge_get_mv(&mv) == 0) {
        advertised_data.battery_mv = (uint16_t)mv;
    }
    advertised_data.active_sensor_bitflags = storage_get_active_sensor_bitflags();
    bt_le_adv_update_data(ad, ARRAY_SIZE(ad), sd, ARRAY_SIZE(sd));
    k_work_reschedule(&advertised_data_work, K_SECONDS(1));
}

static void notif_enabled(bool enabled, void* ctx) {
    ARG_UNUSED(ctx);
    printk("%s() - %s\n", __func__, (enabled ? "Enabled" : "Disabled"));
}

struct bt_nus_cb nus_listener = {
    .notif_enabled = notif_enabled,
    .received = received,
};

static void ble_conn_recycled_cb() {
    // move to work queue
    int err = bt_le_adv_start(BT_LE_ADV_CONN_FAST_1, ad, ARRAY_SIZE(ad), sd, ARRAY_SIZE(sd));
    if (err) {
        LOG_ERR("Failed to re-start advertising: %d", err);
    }
}

static void ble_conn_disconnected_cb(struct bt_conn* conn, uint8_t err) {
    (void)err;
    (void)conn;
    err = bt_le_adv_stop();  // stop non connectable advertising
    if (err) {
        LOG_ERR("Connection failure %d", err);
    }
}

static void ble_conn_connected_cb(struct bt_conn* conn, uint8_t err) {
    (void)err;
    (void)conn;
    // start non connectable advertising to allow scanning
    err = bt_le_adv_start(BT_LE_ADV_NCONN_IDENTITY, ad, ARRAY_SIZE(ad), sd, ARRAY_SIZE(sd));
    if (err) {
        LOG_ERR("Connection failure %d", err);
    }
}

struct bt_conn_cb conn_cb = {.recycled = ble_conn_recycled_cb,
                             .disconnected = ble_conn_disconnected_cb,
                             .connected = ble_conn_connected_cb};

int cmd_processor_init(void) {
    int err;
    err = bt_nus_cb_register(&nus_listener, NULL);
    if (err) {
        LOG_ERR("Failed to register NUS callback: %d", err);
        return err;
    }
    err = bt_enable(NULL);
    if (err) {
        LOG_ERR("Failed to enable bluetooth: %d", err);
        return err;
    }
    bt_conn_cb_register(&conn_cb);

    err = bt_le_adv_start(BT_LE_ADV_CONN_FAST_1, ad, ARRAY_SIZE(ad), sd, ARRAY_SIZE(sd));
    if (err) {
        LOG_ERR("Failed to start advertising: %d", err);
        return err;
    }

    k_work_init_delayable(&advertised_data_work, advertised_data_work_handler);
    k_work_schedule(&advertised_data_work, K_SECONDS(2));
    LOG_INF("Initialization complete");
    return 0;
}
```

## src/imu.c
```c
#include "imu.h"

#include <errno.h>
#include <zephyr/kernel.h>
#include <zephyr/logging/log.h>
#include <zephyr/sys/util.h>

#include "imu_interface.h"
#include "midge_protocol.h"
#include "storage.h"
#include "utility.h"

LOG_MODULE_REGISTER(imu);

static uint8_t imu_sensor_state = SENSOR_STATE_DISABLED;

uint8_t imu_sensor_get_status() { return imu_sensor_state; }

int imu_sensor_init() {
    int ret = imu_drv_api.init();
    if (ret != 0) {
        imu_sensor_state = SENSOR_STATE_ERR;
        LOG_ERR("Failed to initialize IMU driver: %d", ret);
    } else {
        imu_sensor_state = SENSOR_STATE_STOP;
        LOG_INF("IMU driver initialized successfully");
    }
    return ret;
}

int imu_sensor_start(int sample_iter, uint16_t acc_fsr, uint16_t gyr_fsr, uint16_t datarate) {
    struct imu_config config = {
        .acc_fsr = acc_fsr,
        .gyr_fsr = gyr_fsr,
        .datarate = datarate,
    };
    // set config
    int ret = imu_drv_api.set_config(&config);
    if (ret != 0) {
        LOG_ERR("Failed to set IMU config: %d", ret);
        return ret;
    }

    // start sampling
    ret = imu_drv_api.start(sample_iter);
    if (ret != 0) {
        LOG_ERR("Failed to start IMU sampling: %d", ret);
        imu_sensor_state = SENSOR_STATE_ERR;
    } else {
        LOG_INF("IMU sampling started successfully");
        imu_sensor_state = SENSOR_STATE_ACTIVE;
    }
    return ret;
}

int imu_sensor_stop() {
    int ret = imu_drv_api.stop();
    if (ret != 0) {
        LOG_ERR("Failed to stop IMU sampling: %d", ret);
        imu_sensor_state = SENSOR_STATE_ERR;
    } else {
        LOG_INF("IMU sampling stopped successfully");
        imu_sensor_state = SENSOR_STATE_STOP;
    }
    return ret;
}

struct start_imu_work_ctx {
    struct k_work work;
    struct k_sem done;
    uint16_t sample_id;
    uint16_t acc_fsr;
    uint16_t gyr_fsr;
    uint16_t datarate;
    int ret;
};

static void start_imu_work_handler(struct k_work* work) {
    struct start_imu_work_ctx* ctx = CONTAINER_OF(work, struct start_imu_work_ctx, work);
    ctx->ret = imu_sensor_start(ctx->sample_id, ctx->acc_fsr, ctx->gyr_fsr, ctx->datarate);
    k_sem_give(&ctx->done);
}

int cmd_start_imu(uint8_t* data) {
    struct cmd_start_imu_request* req_data = (struct cmd_start_imu_request*)data;
    struct start_imu_work_ctx ctx = {.sample_id = req_data->sample_id,
                                     .acc_fsr = req_data->acc_fsr,
                                     .gyr_fsr = req_data->gyr_fsr,
                                     .datarate = req_data->datarate};
    k_sem_init(&ctx.done, 0, 1);
    k_work_init(&ctx.work, start_imu_work_handler);
    int ret = k_work_submit(&ctx.work);
    if (ret < 0) {
        LOG_ERR("Failed to submit start imu work: %d", ret);
    } else {
        ret = k_sem_take(&ctx.done, K_FOREVER);
        if (ret != 0) {
            LOG_ERR("Failed to take semaphore for start imu work: %d", ret);
        } else {
            ret = ctx.ret;
        }
    }

    struct cmd_start_imu_response* resp_data = (struct cmd_start_imu_response*)data;
    memset(resp_data, 0, sizeof(struct cmd_start_imu_response));
    resp_data->status_code = ret;
    return ret;
}

static void stop_imu_work_handler(struct k_work* work) {
    struct simple_work_ctx* ctx = CONTAINER_OF(work, struct simple_work_ctx, work);
    ctx->ret = imu_sensor_stop();
    k_sem_give(&ctx->done);
}

int cmd_stop_imu(uint8_t* data) {
    // struct cmd_stop_imu_request* req_data = (struct cmd_stop_imu_request*)data;
    struct cmd_stop_imu_response* resp_data = (struct cmd_stop_imu_response*)data;
    struct simple_work_ctx ctx;
    k_work_init(&ctx.work, stop_imu_work_handler);
    k_sem_init(&ctx.done, 0, 1);

    int ret;
    int submit_ret = k_work_submit(&ctx.work);
    if (submit_ret < 0) {
        ret = submit_ret;
    } else {
        k_sem_take(&ctx.done, K_FOREVER);
        ret = ctx.ret;
    }
    resp_data->status_code = ret;
    return ret;
}
```

## src/imu.h
```c
#ifndef MBFW_IMU_H
#define MBFW_IMU_H

#include <inttypes.h>

uint8_t imu_sensor_get_status();

int imu_sensor_init();

int imu_sensor_start(int sample_iter, uint16_t acc_fsr, uint16_t gyr_fsr, uint16_t datarate);

int imu_sensor_stop();

int cmd_start_imu(uint8_t* data);

int cmd_stop_imu(uint8_t* data);

#endif  // MBFW_IMU_H
```

## src/privacy_switch.c
```c
#include "privacy_switch.h"

#include <inttypes.h>
#include <stdbool.h>
#include <zephyr/drivers/gpio.h>
#include <zephyr/kernel.h>
#include <zephyr/logging/log.h>
#include <zephyr/sys/util.h>

#include "audio.h"
#include "midge_protocol.h"

LOG_MODULE_REGISTER(privacy_switch);

static const struct gpio_dt_spec sw_off = GPIO_DT_SPEC_GET(DT_ALIAS(sw_audio_off), gpios);
static const struct gpio_dt_spec sw_low = GPIO_DT_SPEC_GET(DT_ALIAS(sw_audio_low), gpios);
static const struct gpio_dt_spec sw_high = GPIO_DT_SPEC_GET(DT_ALIAS(sw_audio_high), gpios);

static struct gpio_callback sw_callback_data;

K_MUTEX_DEFINE(switch_mutex);

bool debouncing = false;
enum privacy_sw_pos sw_pos = PRIVACY_SWITCH_POS_OFF;

void update_privacy_sw_pos() {
    int off = gpio_pin_get(sw_off.port, sw_off.pin);
    int low = gpio_pin_get(sw_low.port, sw_low.pin);
    int high = gpio_pin_get(sw_high.port, sw_high.pin);
    enum sensor_state state = audio_sensor_get_status();
    if (state == SENSOR_STATE_ACTIVE) {
        audio_sensor_stop();
    }
    LOG_INF("current switch state: off:%d low:%d hi:%d", off, low, high);

    if (off == 1) {
        sw_pos = PRIVACY_SWITCH_POS_OFF;
    } else if (low == 1) {
        sw_pos = PRIVACY_SWITCH_POS_LOW;
    } else if (high == 1) {
        sw_pos = PRIVACY_SWITCH_POS_HIGH;
    } else {
        // no change but weird, log it
        LOG_INF("no position change!");
    }
}

struct k_work_delayable switch_read_work;
void switch_read_work_handler(struct k_work* work) {
    if (k_mutex_lock(&switch_mutex, K_NO_WAIT) == 0) {
        update_privacy_sw_pos();
        debouncing = false;
        k_mutex_unlock(&switch_mutex);
    }
}

void sw_pos_changed(const struct device* dev, struct gpio_callback* cb, uint32_t pins) {
    if (k_mutex_lock(&switch_mutex, K_NO_WAIT) == 0) {
        if (!debouncing) {
            debouncing = true;
        } else {
            // already debouncing, ignore this interrupt
            k_mutex_unlock(&switch_mutex);
            return;
        }
        memset(&switch_read_work, 0, sizeof(switch_read_work));
        k_work_init_delayable(&switch_read_work, switch_read_work_handler);
        k_work_schedule(&switch_read_work, K_MSEC(200));
        k_mutex_unlock(&switch_mutex);
    }
}

int switch_sensor_init() {
    bool gpios_ready =
        gpio_is_ready_dt(&sw_off) || gpio_is_ready_dt(&sw_low) || gpio_is_ready_dt(&sw_high);

    bool gpios_config_done = (gpio_pin_configure_dt(&sw_off, GPIO_INPUT) == 0) &&
                             (gpio_pin_configure_dt(&sw_low, GPIO_INPUT) == 0) &&
                             (gpio_pin_configure_dt(&sw_high, GPIO_INPUT) == 0);

    bool gpios_irq_config_success =
        (gpio_pin_interrupt_configure_dt(&sw_off, GPIO_INT_EDGE_TO_ACTIVE) == 0) &&
        (gpio_pin_interrupt_configure_dt(&sw_low, GPIO_INT_EDGE_TO_ACTIVE) == 0) &&
        (gpio_pin_interrupt_configure_dt(&sw_high, GPIO_INT_EDGE_TO_ACTIVE) == 0);

    gpio_init_callback(&sw_callback_data, sw_pos_changed,
                       BIT(sw_off.pin) | BIT(sw_low.pin) | BIT(sw_high.pin));
    int add_callback_success =
        gpio_add_callback(sw_off.port, &sw_callback_data);  // assume the same port

    if (!gpios_ready || !gpios_config_done || !gpios_irq_config_success ||
        (add_callback_success != 0)) {
        LOG_ERR("Error: Failed during GPIO initialization");
        return -ENXIO;
    }
    update_privacy_sw_pos();
    return 0;
}

enum privacy_sw_pos switch_sensor_position() { return sw_pos; }
```

## src/status_led.h
```c
#ifndef STATUS_LED_H_
#define STATUS_LED_H_

#include <stdbool.h>

int led_init(void);

int led_report_status(int status_code);

int led_report_active(bool active);

int led_identify(void);

#endif
```
