## firmware/boards/others/midge_badge_nrf52/midge_badge_nrf52_defconfig
```kconfig
# Enable MPU
CONFIG_ARM_MPU=y

# enable GPIO
CONFIG_GPIO=y

# Enable RTT
CONFIG_USE_SEGGER_RTT=y

CONFIG_CONSOLE=y
# disable uart driver
CONFIG_UART_CONSOLE=n

# enable console
CONFIG_RTT_CONSOLE=y

# 32kHz clock source
CONFIG_CLOCK_CONTROL_NRF_K32SRC_SYNTH=y
CONFIG_CLOCK_CONTROL_NRF_K32SRC_50PPM=y

# USE OF SPI0 with EasyDMA
#CONFIG_SOC_NRF52832_ALLOW_SPIM_DESPITE_PAN_58=y
#CONFIG_NRF52_ANOMALY_58_WORKAROUND=y
#CONFIG_NRF52_ANOMALY_109_WORKAROUND=n
```

## firmware/boards/others/midge_badge_v1/Kconfig
```kconfig
if BOARD_MIDGE_BADGE_V1

menu "midge_badge_v1 specific options"
choice MIDGE_SEL_IMU
	prompt "IMU selection"
	default MIDGE_SEL_IMU_ICM20948

config MIDGE_SEL_IMU_ICM20948
	bool "ICM20948"

config MIDGE_SEL_IMU_ICM42605
	bool "ICM42605"

endchoice

endmenu

config MIDGE_IMU_ICM20948_USE_CLOSED_DRIVER
	bool "Use closed-source driver for ICM20948"
	depends on MIDGE_SEL_IMU_ICM20948
	default y
	help
	  Enable to use the closed-source ICM20948 driver.
	  Disable to use the Zephyr native ICM20948 driver.

endif # BOARD_MIDGE_BADGE_V1
```

## firmware/boards/others/midge_badge_v1/Kconfig.defconfig
```kconfig
if BOARD_MIDGE_BADGE_V1

config HW_STACK_PROTECTION
	default ARCH_HAS_STACK_PROTECTION


config SENSOR
	default y if (MIDGE_SEL_IMU_ICM20948 || MIDGE_SEL_IMU_ICM42605) && !MIDGE_IMU_ICM20948_USE_CLOSED_DRIVER
	default n

endif
```

## firmware/boards/others/midge_badge_v1/board.yml
```yaml
board:
  name: midge_badge_v1
  full_name: SPCL Midge Badge
  vendor: others
  socs:
    - name: nrf52832
```

## firmware/boards/others/midge_badge_v2/Kconfig
```kconfig
if BOARD_MIDGE_BADGE_V2

menu "midge_badge_v2 specific options"

choice MIDGE_SEL_IMU
	prompt "IMU selection"
	default MIDGE_SEL_IMU_GENERIC_MAG_COMBO

config MIDGE_SEL_IMU_GENERIC_MAG_COMBO
	bool "Generic IMU + Magnetometer combo"

endchoice

endmenu

endif # BOARD_MIDGE_BADGE_V2
```

## firmware/boards/others/midge_badge_v2/Kconfig.defconfig
```kconfig
if BOARD_MIDGE_BADGE_V2

config HW_STACK_PROTECTION
	default ARCH_HAS_STACK_PROTECTION

endif
```

## firmware/boards/others/midge_badge_v2/board.yml
```yaml
board:
  name: midge_badge_v2
  full_name: SPCL Midge Badge v2
  vendor: others
  socs:
    - name: nrf52840
```

## firmware/boards/others/midge_badge_v2/midge_badge_v2_defconfig
```kconfig
# Enable MPU
CONFIG_ARM_MPU=y

# enable GPIO
CONFIG_GPIO=y

# Enable RTT
CONFIG_USE_SEGGER_RTT=y

CONFIG_CONSOLE=y
# disable uart driver
CONFIG_UART_CONSOLE=n

# enable console
CONFIG_RTT_CONSOLE=y

# 32kHz clock source
CONFIG_CLOCK_CONTROL_NRF_K32SRC_SYNTH=y
CONFIG_CLOCK_CONTROL_NRF_K32SRC_50PPM=y

# open source imu drivers
CONFIG_SENSOR=y
CONFIG_MCN_AUDIO_BUFFERS=50
CONFIG_LSM6DSO_TRIGGER_GLOBAL_THREAD=y
#CONFIG_SEGGER_DEBUGMON=y
CONFIG_CORTEX_M_DEBUG_MONITOR_HOOK=y
```
